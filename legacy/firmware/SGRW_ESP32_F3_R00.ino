#include <Wire.h>
#include <Adafruit_GFX.h>
#include <Adafruit_SSD1306.h>

// ==========================================
// 1. MAPEAMENTO DE PINOS E HARDWARE
// ==========================================
// I2C (Display OLED)
#define I2C_SDA 21
#define I2C_SCL 22
#define SCREEN_WIDTH 128
#define SCREEN_HEIGHT 64
#define OLED_RESET -1
Adafruit_SSD1306 display(SCREEN_WIDTH, SCREEN_HEIGHT, &Wire, OLED_RESET);

// Sensores e Entradas Analógicas/Digitais
#define PINO_SOLO1 32   // Sensor Capacitivo Vaso 1
#define PINO_SOLO2 33   // Sensor Capacitivo Vaso 2
#define PINO_FLUXO 25   // Sensor de Fluxo YF-S401
#define PINO_BOIA 26    // Boia de Nível
#define PINO_BOOT 0     // Botão interno do ESP32 para reset do galão

// Atuadores (Relés com Low Level Trigger)
#define RELE_LUZ 18     // CH1 - Quantum Board
#define RELE_BOMBA 19   // CH2 - Bomba de Água
#define RELE_ON LOW
#define RELE_OFF HIGH

// ==========================================
// 2. VARIÁVEIS GLOBAIS E CALIBRAÇÃO
// ==========================================
// Calibração do Solo (Valores que você refinará amanhã)
const int SOLO_AR = 3380;
const int SOLO_AGUA = 1250;
int umidadeSolo1Pct = 0;
int umidadeSolo2Pct = 0;
bool nivelGalaoBaixo = false; 

// Variáveis de Tempo (Lógica Non-blocking)
unsigned long tempoAnteriorLuz = 0;
const long intervaloLuz = 20000; // 20s para o Blink de teste da luz
bool estadoLuz = false;

unsigned long tempoAnteriorSensores = 0;
const long intervaloSensores = 2000; // Atualiza leituras e visor a cada 2s

// Variáveis de Autonomia
volatile bool flagGalaoCheio = false; 
int diasAutonomia = 0; 

// Variáveis de Hidráulica e Fluxo
volatile int pulsosFluxo = 0;
float fatorCalibracaoFluxo = 5.88; // Pulsos por mL (Ajustar nos testes amanhã)
bool executandoRega = false;
float volumeAlvo_mL = 0.0;
float volumeAtual_mL = 0.0;

// ==========================================
// 3. ATIVOS GRÁFICOS (BITMAP)
// ==========================================
const unsigned char epd_bitmap_JPEG_Folha [] PROGMEM = {
0x00, 0x00, 0x00, 0x00, 0x00, 0x00, 0x00, 0x00, 0x00, 0x00, 0x00, 0x00, 0x00, 0x00, 0x00, 0x00,
0x00, 0x00, 0x00, 0x00, 0x00, 0x00, 0x00, 0x00, 0x00, 0x00, 0x00, 0x00, 0x00, 0x00, 0x00, 0x00,
0x00, 0x00, 0x00, 0x00, 0x00, 0x00, 0x00, 0x00, 0x00, 0x00, 0x00, 0x00, 0x00, 0x00, 0x00, 0x00,
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0x00, 0x00, 0x00, 0x00, 0x00, 0x00, 0x00, 0x00, 0x00, 0x00, 0x00, 0x00, 0x00, 0x00, 0x00, 0x00
};

// ==========================================
// 4. INTERRUPÇÕES DE HARDWARE
// ==========================================
void IRAM_ATTR ISR_ResetGalao() {
  flagGalaoCheio = true;
}

void IRAM_ATTR ISR_ContaPulso() {
  pulsosFluxo++;
}

// ==========================================
// 5. SETUP INICIAL
// ==========================================
void setup() {
  Serial.begin(115200);
  Wire.begin(I2C_SDA, I2C_SCL);

  if(!display.begin(SSD1306_SWITCHCAPVCC, 0x3C)) {
    Serial.println(F("Falha na inicializacao do OLED"));
    for(;;);
  }
  display.clearDisplay();
  display.setTextColor(SSD1306_WHITE);
  display.display();

  // Entradas e Pull-Ups
  pinMode(PINO_BOIA, INPUT_PULLUP);
  pinMode(PINO_BOOT, INPUT_PULLUP);
  pinMode(PINO_FLUXO, INPUT_PULLUP); 

  // Relés
  pinMode(RELE_LUZ, OUTPUT);
  pinMode(RELE_BOMBA, OUTPUT);
  digitalWrite(RELE_LUZ, RELE_OFF);
  digitalWrite(RELE_BOMBA, RELE_OFF);

  // Ativação das Interrupções
  attachInterrupt(digitalPinToInterrupt(PINO_BOOT), ISR_ResetGalao, FALLING);
  attachInterrupt(digitalPinToInterrupt(PINO_FLUXO), ISR_ContaPulso, FALLING);

  Serial.println(F("=== SMARTGROW INICIADO: FASES 1, 2 E 3 ==="));
  Serial.println(F("Aguardando comandos (Envie 'R' para regar 100mL)"));
}

// ==========================================
// 6. LOOP PRINCIPAL
// ==========================================
void loop() {
  unsigned long tempoAtual = millis();

  // ------------------------------------------------
  // A. RESET DO GALÃO (Botão BOOT)
  // ------------------------------------------------
  if (flagGalaoCheio) {
    diasAutonomia = 0; 
    flagGalaoCheio = false;
    Serial.println(">>> Galão resetado via painel físico!");
  }

  // ------------------------------------------------
  // B. ATUALIZAÇÃO DOS SENSORES E DISPLAY (2 Segundos)
  // ------------------------------------------------
  if (tempoAtual - tempoAnteriorSensores >= intervaloSensores) {
    tempoAnteriorSensores = tempoAtual;

    // 1. Leitura e Conversão do Solo 1
    int leituraBruta1 = analogRead(PINO_SOLO1);
    umidadeSolo1Pct = map(leituraBruta1, SOLO_AR, SOLO_AGUA, 0, 100);
    umidadeSolo1Pct = constrain(umidadeSolo1Pct, 0, 100);

    // 2. Leitura e Conversão do Solo 2
    int leituraBruta2 = analogRead(PINO_SOLO2);
    umidadeSolo2Pct = map(leituraBruta2, SOLO_AR, SOLO_AGUA, 0, 100);
    umidadeSolo2Pct = constrain(umidadeSolo2Pct, 0, 100);

    // 3. Leitura da Boia
    nivelGalaoBaixo = (digitalRead(PINO_BOIA) == HIGH); 

    // --- REFRESH DO DISPLAY ---
    display.clearDisplay();
    display.drawBitmap(0, 0, epd_bitmap_JPEG_Folha, 128, 64, SSD1306_WHITE);

    // Geometria de Texto à direita da folha
    int areaTextX = 52;
    int areaTextWidth = 128 - 52; 
    int baseY = 5; // Subi levemente o Y inicial para caber as 3 linhas com folga

    // Linha 1 (Autonomia)
    int widthDiasNum = 36; // Tamanho 3 = 18px por char
    int widthDiasTxt = 24; // Tamanho 1 = 6px por char
    int gapLinha1 = 2;
    int totalWidthL1 = widthDiasNum + gapLinha1 + widthDiasTxt;
    int cursorX_L1 = areaTextX + (areaTextWidth - totalWidthL1) / 2;

    display.setTextSize(3);
    display.setCursor(cursorX_L1, baseY);
    if (diasAutonomia < 10 && diasAutonomia >= 0) display.print("0");
    display.print(diasAutonomia);

    display.setTextSize(1);
    display.setCursor(cursorX_L1 + widthDiasNum + gapLinha1, baseY + 16);
    display.print("dias");

    // Linhas 2 e 3 (Sensores de Solo 1 e 2 empilhados em Tamanho 1)
    // Texto ex: "s1: XX%" = 7 caracteres * 6px = 42 pixels de largura
    int widthSolo = 42;
    int cursorX_Solo = areaTextX + (areaTextWidth - widthSolo) / 2;
    
    // Solo 1
    int cursorY_S1 = baseY + 32; // Distância logo abaixo dos dias
    display.setTextSize(1);
    display.setCursor(cursorX_Solo, cursorY_S1);
    display.print("s1: ");
    if (umidadeSolo1Pct < 10 && umidadeSolo1Pct >= 0) display.print("0");
    display.print(umidadeSolo1Pct);
    display.print("%");

    // Solo 2
    int cursorY_S2 = cursorY_S1 + 12; // 12 pixels abaixo do S1
    display.setCursor(cursorX_Solo, cursorY_S2);
    display.print("s2: ");
    if (umidadeSolo2Pct < 10 && umidadeSolo2Pct >= 0) display.print("0");
    display.print(umidadeSolo2Pct);
    display.print("%");

    // Aviso de Segurança (Boia)
    if (nivelGalaoBaixo) {
       // Se der alerta, apagamos as duas linhas de solo (S1 e S2) para destacar a emergência
       display.fillRect(areaTextX, cursorY_S1, areaTextWidth, 24, SSD1306_BLACK); 
       
       int xAlerta = areaTextX + (areaTextWidth - 42) / 2;
       int xNivel = areaTextX + (areaTextWidth - 66) / 2;

       display.setTextSize(1);
       display.setCursor(xAlerta, cursorY_S1);
       display.print("ALERTA:");
       display.setCursor(xNivel, cursorY_S2);
       display.print("NIVEL BAIXO");
    }
    display.display();

    // --- LOGS PARA DEPURAÇÃO AMANHÃ ---
    Serial.print("Solo 1 -> Bruto: "); Serial.print(leituraBruta1); Serial.print(" | "); Serial.print(umidadeSolo1Pct); Serial.println("%");
    Serial.print("Solo 2 -> Bruto: "); Serial.print(leituraBruta2); Serial.print(" | "); Serial.print(umidadeSolo2Pct); Serial.println("%");
    Serial.println("-----------------------------------");
  }

  // ------------------------------------------------
  // C. TESTE DA QUANTUM BOARD (Blink 20s)
  // ------------------------------------------------
  if (tempoAtual - tempoAnteriorLuz >= intervaloLuz) {
    tempoAnteriorLuz = tempoAtual;
    estadoLuz = !estadoLuz;
    digitalWrite(RELE_LUZ, estadoLuz ? RELE_ON : RELE_OFF);
  }

  // ------------------------------------------------
  // D. GATILHO DE REGA VIA SERIAL (Hidráulica)
  // ------------------------------------------------
  if (Serial.available() > 0) {
    char comando = Serial.read();
    if ((comando == 'R' || comando == 'r') && !executandoRega) {
      if (!nivelGalaoBaixo) { 
        iniciarRega(100.0); // Alvo de 100mL (Altere aqui se quiser testar volumes maiores amanhã)
      } else {
        Serial.println("BLOQUEIO: Boia acusa falta de água no reservatório!");
      }
    }
  }

  // ------------------------------------------------
  // E. CONTROLE DE DISPERSÃO (Parada via Fluxo ou Boia)
  // ------------------------------------------------
  if (executandoRega) {
    // Leitura volátil segura
    noInterrupts();
    int copiapulsos = pulsosFluxo;
    interrupts();

    volumeAtual_mL = copiapulsos / fatorCalibracaoFluxo;

    // Se bateu a meta ou a água do galão acabou no meio da rega
    if (volumeAtual_mL >= volumeAlvo_mL || digitalRead(PINO_BOIA) == HIGH) {
      digitalWrite(RELE_BOMBA, RELE_OFF); // Desliga a bomba imediatamente
      executandoRega = false;
      Serial.print(">>> Rega encerrada. Total bombeado: ");
      Serial.print(volumeAtual_mL);
      Serial.println(" mL");
    }
  }
}

// ==========================================
// FUNÇÕES AUXILIARES
// ==========================================
void iniciarRega(float volume_mL) {
  volumeAlvo_mL = volume_mL;
  volumeAtual_mL = 0.0;
  
  noInterrupts();
  pulsosFluxo = 0; // Zera a contagem da hélice para começar do zero
  interrupts();
  
  executandoRega = true;
  digitalWrite(RELE_BOMBA, RELE_ON); // Liga a bomba
  
  Serial.print(">>> Acionando Bomba! Alvo programado: ");
  Serial.print(volumeAlvo_mL);
  Serial.println(" mL...");
}